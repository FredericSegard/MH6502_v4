; Video Display Processor (VDP) - TMS99x8A
VDP_VRAM		= $7720		; Video RAM
VDP_REG			= $7721		; Register

; CONSTANTS
VDP_WRITE_VRAM_BIT	= $40
VDP_REGISTER_BITS	= $80
VDP_NAME_TABLE 		= $1400
VDP_PATTERN_TABLE	= $0800

;              _                   _           _   _   
; __   __   __| |  _ __           (_)  _ __   (_) | |_ 
; \ \ / /  / _` | | '_ \          | | | '_ \  | | | __|
;  \ V /  | (_| | | |_) |         | | | | | | | | | |_ 
;   \_/    \__,_| | .__/   _____  |_| |_| |_| |_|  \__|
;                 |_|     |_____|                      

; Initialize the VDP (TMS9918A)
; -----------------------------
; INPUT:  n/a
; OUTPUT: n/a

vdp_init:
	jsr	vdp_reg_reset
	jsr	vdp_init_pattern_table
	jsr	vdp_clear_display
	stz	VDP_X_POS
	stz	VDP_Y_POS
	
	lda	#<vdpmsg		; Get LSB address of msg
	sta	TEMP
	lda	#>vdpmsg		; Get MSB address of msg
	sta	TEMP+1
	jsr	vdp_print_string	; Write message

	rts

vdpmsg:	.byte	"MH6502-4 @ 4MHz, BIOS v3.05             "
	.byte	"32K ROM, 30K RAM, 2K NVRAM + RTC        "
	.byte	"                                        "
	.byte	"Hello World!", 0

vdp_reg_reset:
	pha
	phx
	ldx	#0
vdp_reg_reset_loop:
	lda	vdp_register_inits, x
	sta	VDP_REG
	nop
	nop
	
	txa
	ora	#VDP_REGISTER_BITS
	sta	VDP_REG
	nop
	nop
	
	inx
	cpx	#8
	bne	vdp_reg_reset_loop
	plx
	pla
	rts

vdp_init_pattern_table:
	pha					; Save A
	lda	#<(VDP_PATTERN_TABLE)		; Load LSB of pattern table address
	sta	VDP_REG				; Save to VDP register
	nop
	nop
	
	lda	#(VDP_WRITE_VRAM_BIT | >VDP_PATTERN_TABLE) ; Load MSB of pattern table address
	sta	VDP_REG				; Save to VDB register
	nop
	nop
	
	lda	#<vdp_patterns			; Get pattern table address LSB
	sta	VDP_PATTERN_INIT		; Store LSB which will act as a pointer
	lda	#>vdp_patterns			; Get pattern table address MSB
	sta	VDP_PATTERN_INIT+1		; Store MSB which will act as a pointer
vdp_pattern_table_loop:
	lda	(VDP_PATTERN_INIT)		; Load a pattern stored in pattern table
	sta	VDP_VRAM			; Store it in VRAM
	nop
	nop
	
	lda	VDP_PATTERN_INIT		; Load pattern table LSB
	clc					; Clear carry
	adc	#1				; Increment address LSB
	sta	VDP_PATTERN_INIT		; Store new LSB address pointer
	lda	#0				; Clear A
	adc	VDP_PATTERN_INIT+1		; Increment address MSB if carry is set
	sta	VDP_PATTERN_INIT+1		; Store new MSB address pointer
	cmp	#>vdp_end_patterns		; Has the end of the (MSB) pattern table been reached?
	bne	vdp_pattern_table_loop		; No, then loop to next pattern
	lda	VDP_PATTERN_INIT		; Load LSB address pointer
	cmp	#<vdp_end_patterns		; Has the end of the (LSB) pattern table been reached?
	bne	vdp_pattern_table_loop		; No, then loop to next pattern
	pla					; Restore A
	rts					; End routine

;              _                                        _       _                     _   _                 _                 
; __   __   __| |  _ __           ___   _ __     __ _  | |__   | |   ___           __| | (_)  ___   _ __   | |   __ _   _   _ 
; \ \ / /  / _` | | '_ \         / _ \ | '_ \   / _` | | '_ \  | |  / _ \         / _` | | | / __| | '_ \  | |  / _` | | | | |
;  \ V /  | (_| | | |_) |       |  __/ | | | | | (_| | | |_) | | | |  __/        | (_| | | | \__ \ | |_) | | | | (_| | | |_| |
;   \_/    \__,_| | .__/  _____  \___| |_| |_|  \__,_| |_.__/  |_|  \___|  _____  \__,_| |_| |___/ | .__/  |_|  \__,_|  \__, |
;                 |_|    |_____|                                          |_____|                  |_|                  |___/ 
		 
; Enables display
; ---------------

vdp_enable_display:
	pha
	lda	vdp_reg_1			; Get register 1 values
	ora	#%01000000			; Enable display (bit 6 = 1)
	sta	VDP_REG				;
	nop
	nop
	
	lda	#(VDP_REGISTER_BITS | 1)	; Store to register 1
	sta	VDP_REG
	nop
	nop
	
	pla
	rts

;              _                     _   _                 _       _                     _   _                 _                 
; __   __   __| |  _ __           __| | (_)  ___    __ _  | |__   | |   ___           __| | (_)  ___   _ __   | |   __ _   _   _ 
; \ \ / /  / _` | | '_ \         / _` | | | / __|  / _` | | '_ \  | |  / _ \         / _` | | | / __| | '_ \  | |  / _` | | | | |
;  \ V /  | (_| | | |_) |       | (_| | | | \__ \ | (_| | | |_) | | | |  __/        | (_| | | | \__ \ | |_) | | | | (_| | | |_| |
;   \_/    \__,_| | .__/  _____  \__,_| |_| |___/  \__,_| |_.__/  |_|  \___|  _____  \__,_| |_| |___/ | .__/  |_|  \__,_|  \__, |
;                 |_|    |_____|                                             |_____|                  |_|                  |___/ 
		 
; Disables display
; ----------------

vdp_disable_display:
	pha
	lda	vdp_reg_1
	and	#%10111111			; Disable display (bit 6 = 0)
	sta	VDP_REG
	nop
	nop
	
	lda	#(VDP_REGISTER_BITS | 1)	; Store to register 1
	sta	VDP_REG
	nop
	nop
	
	pla
	rts

;              _                        _                                   _   _                 _                 
; __   __   __| |  _ __           ___  | |   ___    __ _   _ __          __| | (_)  ___   _ __   | |   __ _   _   _ 
; \ \ / /  / _` | | '_ \         / __| | |  / _ \  / _` | | '__|        / _` | | | / __| | '_ \  | |  / _` | | | | |
;  \ V /  | (_| | | |_) |       | (__  | | |  __/ | (_| | | |          | (_| | | | \__ \ | |_) | | | | (_| | | |_| |
;   \_/    \__,_| | .__/  _____  \___| |_|  \___|  \__,_| |_|    _____  \__,_| |_| |___/ | .__/  |_|  \__,_|  \__, |
;                 |_|    |_____|                                |_____|                  |_|                  |___/ 
		 
; Clear text mode display by writing all spaces in VRAM
; -----------------------------------------------------

vdp_clear_display:
	pha
	phx
	phy
	
	lda	#<VDP_NAME_TABLE
	sta	VDP_REG
	nop
	nop
	
	lda	#(VDP_WRITE_VRAM_BIT | >VDP_NAME_TABLE)
	sta	VDP_REG
	nop
	nop
	
	lda	#$20
	ldy	#24
vdp_clear_display_loop_Y:
	ldx	#40
vdp_clear_display_loop_X:

	sta	VDP_VRAM
	nop
	nop
	
	dex
	bne	vdp_clear_display_loop_X
	dey
	bne	vdp_clear_display_loop_Y
	
	ply
	plx
	pla
	rts


;              _                                 _           _                   _                    
; __   __   __| |  _ __           _ __    _ __  (_)  _ __   | |_           ___  | |__     __ _   _ __ 
; \ \ / /  / _` | | '_ \         | '_ \  | '__| | | | '_ \  | __|         / __| | '_ \   / _` | | '__|
;  \ V /  | (_| | | |_) |        | |_) | | |    | | | | | | | |_         | (__  | | | | | (_| | | |   
;   \_/    \__,_| | .__/  _____  | .__/  |_|    |_| |_| |_|  \__|  _____  \___| |_| |_|  \__,_| |_|   
;                 |_|    |_____| |_|                              |_____|                             

; Print a character on the VDP
; ----------------------------

vdp_print_char:
	sta	VDP_VRAM
	nop
	nop
	
	rts


;              _                                 _           _                   _            _                 
; __   __   __| |  _ __           _ __    _ __  (_)  _ __   | |_           ___  | |_   _ __  (_)  _ __     __ _ 
; \ \ / /  / _` | | '_ \         | '_ \  | '__| | | | '_ \  | __|         / __| | __| | '__| | | | '_ \   / _` |
;  \ V /  | (_| | | |_) |        | |_) | | |    | | | | | | | |_          \__ \ | |_  | |    | | | | | | | (_| |
;   \_/    \__,_| | .__/  _____  | .__/  |_|    |_| |_| |_|  \__|  _____  |___/  \__| |_|    |_| |_| |_|  \__, |
;                 |_|    |_____| |_|                              |_____|                                 |___/ 
		 
; Print a string on the VDP
; -------------------------

vdp_print_string:
	pha
	phy
	lda	#<VDP_NAME_TABLE
	sta	VDP_REG
	nop
	nop
	
	lda	#(VDP_WRITE_VRAM_BIT | >VDP_NAME_TABLE)
	sta	VDP_REG
	nop
	nop
	
	ldy	#0			;
vdp_print_string_loop:
	lda	(TEMP),y		;
	beq	vdp_print_string_end	;
	jsr	vdp_print_char		;
	iny
	bne	vdp_print_string_loop	;
vdp_print_string_end:
	ply
	pla
	rts

	
vdp_register_inits:
vdp_reg_0:	.byte	%00000000	; Bit1 = Mode 3 (Graphic Mode II), Bit0 = External video (External VDP plane)
vdp_reg_1:	.byte	%11010000	; Bit7 = 4K/16K, Bit6 = Display Blank, Bit5 = Interrupt Enable, Bit4 = Mode 1
					; Bit3 = Mode 2, Bit2 = Reserved, Bit1 = Sprite Size, Bit0 = Sprite Magnification
vdp_reg_2:	.byte	$05		; Start address of Name Table (reg2 * 0x400)
vdp_reg_3:	.byte	$80		; Start address of Color Table (reg3 * 0x40)
vdp_reg_4:	.byte	$01		; Start address of Pattern Table (reg4 * 0x800)
vdp_reg_5:	.byte	$20		; Start address of Sprite Attribute Table (reg5 * 0x80)
vdp_reg_6:	.byte	$00		; Start address of Sprite Pattern Table (reg6 * 0x800)
vdp_reg_7:	.byte	$F4		; Upper nibble is color of text in Text Mode, lower nibble is bg color in all modes
					; 0:  Transparent	8:  Medium red
					; 1:  Black		9:  Light red
					; 2:  Medium green	A:  Dark yellow
					; 3:  Light green	B:  Light yellow
					; 4:  Dark blue		C:  Dark green
					; 5:  Light blue	D:  Magenta
					; 6:  Dark red		E:  Grey
					; 7:  Cyan		F:  White
vdp_patterns:

	.byte	$00, $00, $00, $00, $00, $00, $00, $00	; (.)
	.byte	$00, $38, $40, $70, $40, $38, $00, $FE	; (.)
	.byte	$00, $20, $20, $20, $24, $18, $00, $FE	; (.)
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	.byte	$00, $00, $00, $10, $08, $00, $00, $00	; (.)

vdp_end_patterns:
	.byte $00
		